## CMakeLists.txt
```
cmake_minimum_required(VERSION 3.8.2)
include($ENV{ZEPHYR_BASE}/cmake/app/boilerplate.cmake NO_POLICY_SCOPE)
project(nrf52_power_mgr)

FILE(GLOB app_sources src/main.c)
target_sources(app PRIVATE ${app_sources})
zephyr_sources_ifdef(CONFIG_PM_CONTROL_APP src/device.c src/power.c)
```

## prj.conf
```kconfig
CONFIG_BT=n
CONFIG_TIMESLICING=n
CONFIG_SYS_POWER_MANAGEMENT=y
CONFIG_SYS_POWER_SLEEP_STATES=y
CONFIG_SYS_POWER_DEEP_SLEEP_STATES=y
CONFIG_DEVICE_POWER_MANAGEMENT=y
CONFIG_SYS_PM_STATE_LOCK=y
CONFIG_SYS_PM_MIN_RESIDENCY_SLEEP_1=5000
CONFIG_SYS_PM_MIN_RESIDENCY_SLEEP_2=15000
CONFIG_GPIO=y

CONFIG_I2C=n

CONFIG_LOG=y
CONFIG_LOG_PRINTK=y
CONFIG_USE_SEGGER_RTT=y
CONFIG_LOG_BACKEND_UART=n
CONFIG_LOG_BACKEND_RTT=y
CONFIG_LOG_BACKEND_RTT_MODE_DROP=y
CONFIG_LOG_BACKEND_RTT_BUFFER=1
```

## src/main.c
```c
/*
 * Copyright (c) 2016 Intel Corporation.
 *
 * SPDX-License-Identifier: Apache-2.0
 */

#include "sample.h"

#define BUSY_WAIT_DELAY_US		(10 * 1000000)

#define LPS1_STATE_ENTER_TO		10
#define LPS2_STATE_ENTER_TO		30
#define DEEP_SLEEP_STATE_ENTER_TO	90

#define DEMO_DESCRIPTION	\
	"Demo Description\n"	\
	"Application creates idleness, due to which System Idle Thread is\n"\
	"scheduled and it enters into various Low Power States.\n"\

struct device *gpio_port;

/* Application main Thread */
void main(void)
{
	u32_t level = 0U;

	printk("\n\n*** Power Management Demo on %s ***\n", CONFIG_BOARD);
	printk(DEMO_DESCRIPTION);

	gpio_port = device_get_binding(PORT);

	/* Configure Button 1 as deep sleep trigger event */
	gpio_pin_configure(gpio_port, BUTTON_1, GPIO_DIR_IN
						| GPIO_PUD_PULL_UP);

	/* Configure Button 2 as wake source from deep sleep */
	gpio_pin_configure(gpio_port, BUTTON_2, GPIO_DIR_IN
						| GPIO_PUD_PULL_UP
						| GPIO_INT | GPIO_INT_LEVEL
						| GPIO_CFG_SENSE_LOW);

	gpio_pin_enable_callback(gpio_port, BUTTON_2);

	/* Configure LEDs */
	gpio_pin_configure(gpio_port, LED_1, GPIO_DIR_OUT);
	gpio_pin_write(gpio_port, LED_1, LED_ON);

	gpio_pin_configure(gpio_port, LED_2, GPIO_DIR_OUT);
	gpio_pin_write(gpio_port, LED_2, LED_ON);

	struct device *gpio0_port = device_get_binding("GPIO_0");
	struct device *gpio1_port = device_get_binding("GPIO_1");
	gpio_pin_configure(gpio0_port, 7, GPIO_DIR_OUT);
	gpio_pin_configure(gpio1_port, 9, GPIO_DIR_OUT);
	gpio_pin_configure(gpio0_port, 12, GPIO_DIR_OUT);
	gpio_pin_write(gpio0_port, 7, 1);
	gpio_pin_write(gpio1_port, 9, 1);
	gpio_pin_write(gpio0_port, 12, 1);


	// super duper

	//gpio_pin_configure(gpio0_port, 17, GPIO_DIR_OUT);
	gpio_pin_configure(gpio0_port, 23, GPIO_DIR_OUT);
	gpio_pin_write(gpio0_port, 23, 1);
	//gpio_pin_write(gpio0_port, 17, 0);
	/*
	 * Start the demo.
	 */
	for (int i = 1; i <= 8; i++) {
		unsigned int sleep_seconds;

		switch (i) {
		case 3:
			printk("\n<-- Disabling %s state --->\n",
					STRINGIFY(SYS_POWER_STATE_SLEEP_3));
			sys_pm_ctrl_disable_state(SYS_POWER_STATE_SLEEP_3);
			break;

		case 5:
			printk("\n<-- Enabling %s state --->\n",
				       STRINGIFY(SYS_POWER_STATE_SLEEP_3));
			sys_pm_ctrl_enable_state(SYS_POWER_STATE_SLEEP_3);

			printk("<-- Disabling %s state --->\n",
					STRINGIFY(SYS_POWER_STATE_SLEEP_2));
			sys_pm_ctrl_disable_state(SYS_POWER_STATE_SLEEP_2);
			break;

		case 7:
			printk("\n<-- Enabling %s state --->\n",
				       STRINGIFY(SYS_POWER_STATE_SLEEP_2));
			sys_pm_ctrl_enable_state(SYS_POWER_STATE_SLEEP_2);

			printk("<-- Forcing %s state --->\n",
				       STRINGIFY(SYS_POWER_STATE_SLEEP_3));
			sys_pm_force_power_state(SYS_POWER_STATE_SLEEP_3);
			break;

		default:
			/* Do nothing. */
			break;
		}

		printk("\n<-- App doing busy wait for 10 Sec -->\n");
		k_busy_wait(BUSY_WAIT_DELAY_US);

		sleep_seconds = (i % 2 != 0) ? LPS1_STATE_ENTER_TO :
					       LPS2_STATE_ENTER_TO;

		printk("\n<-- App going to sleep for %u Sec -->\n",
							sleep_seconds);
		k_sleep(K_SECONDS(sleep_seconds));
	}

	/* Restore automatic power management. */
	printk("\n<-- Forcing %s state --->\n",
		       STRINGIFY(SYS_POWER_STATE_AUTO));
	sys_pm_force_power_state(SYS_POWER_STATE_AUTO);

	printk("\nPress BUTTON1 to enter into Deep Sleep state. "
			"Press BUTTON2 to exit Deep Sleep state\n");
	while (1) {
		gpio_pin_read(gpio_port, BUTTON_1, &level);
		if (level == LOW) {
			k_sleep(K_SECONDS(DEEP_SLEEP_STATE_ENTER_TO));
		}
		k_busy_wait(1000);
	}
}
```

## src/device.c
```c
/*
 * Copyright (c) 2018 Intel Corporation.
 *
 * SPDX-License-Identifier: Apache-2.0
 */

#include "test.h"

static struct device *gpiob;
static struct device *device_list;
static int device_count;

/*
 * Example ordered list to store devices on which
 * device power policies would be executed.
 */
#define DEVICE_POLICY_MAX 15
static char device_ordered_list[DEVICE_POLICY_MAX];
static char device_retval[DEVICE_POLICY_MAX];

/* Initialize and configure GPIO */
/*
void gpio_setup(void)
{

	gpiob = device_get_binding(PORT);

	gpio_pin_configure(gpiob, BUTTON_1, GPIO_DIR_IN
										| GPIO_PUD_PULL_UP);

	gpio_pin_configure(gpiob, BUTTON_2, GPIO_DIR_IN
										| GPIO_PUD_PULL_UP
										| GPIO_INT | GPIO_INT_LEVEL
										| GPIO_CFG_SENSE_LOW);

	gpio_pin_enable_callback(gpiob, BUTTON_2);
}
*/
void suspend_devices(void)
{

	for (int i = device_count - 1; i >= 0; i--) {
		int idx = device_ordered_list[i];

		/* If necessary  the policy manager can check if a specific
		 * device in the device list is busy as shown below :
		 * if(device_busy_check(&device_list[idx])) {do something}
		 */
		device_retval[i] = device_set_power_state(&device_list[idx],
												  DEVICE_PM_SUSPEND_STATE);
	}
}

void resume_devices(void)
{
	int i;

	for (i = 0; i < device_count; i++) {
		if (!device_retval[i]) {
			int idx = device_ordered_list[i];

			device_set_power_state(&device_list[idx],
								   DEVICE_PM_ACTIVE_STATE);
		}
	}
}

void create_device_list(void)
{
	int count;
	int i;

	/*
	 * Following is an example of how the device list can be used
	 * to suspend devices based on custom policies.
	 *
	 * Create an ordered list of devices that will be suspended.
	 * Ordering should be done based on dependencies. Devices
	 * in the beginning of the list will be resumed first.
	 */
	device_list_get(&device_list, &count);
	device_count = 4; /* Reserve for 32KHz, 16MHz, system clock, and uart */

	for (i = 0; (i < count) && (device_count < DEVICE_POLICY_MAX); i++) {
		if (!strcmp(device_list[i].config->name, "clk_k32src")) {
			device_ordered_list[0] = i;
		} else if (!strcmp(device_list[i].config->name, "clk_m16src")) {
			device_ordered_list[1] = i;
		} else if (!strcmp(device_list[i].config->name, "sys_clock")) {
			device_ordered_list[2] = i;
		} else if (!strcmp(device_list[i].config->name, "UART_0")) {
			device_ordered_list[3] = i;
		} else {
			device_ordered_list[device_count++] = i;
		}
	}
}
```

## src/power.c
```c
/*
 * Copyright (c) 2018 Nordic Semiconductor ASA.
 *
 * SPDX-License-Identifier: Apache-2.0
 */

#include "sample.h"

/*
 * Application defined function for doing any target specific operations
 * for low power entry.
 */
void sys_pm_notify_power_state_entry(enum power_states state)
{
	switch (state) {
	case SYS_POWER_STATE_SLEEP_2:
		printk("--> Entering to SYS_POWER_STATE_SLEEP_2 state.\n");

		/*
		 * This power state is implemented by this sample.
		 * Perform enter to the low power state by turning off LED2.
		 */
		//gpio_pin_write(gpio_port, LED_1, LED_ON);
		//gpio_pin_write(gpio_port, LED_2, LED_OFF);
		k_cpu_idle();
		break;

	case SYS_POWER_STATE_SLEEP_3:
		printk("--> Entering to SYS_POWER_STATE_SLEEP_3 state.\n");

		/*
		 * This power state is implemented by this sample.
		 * Perform enter to the low power state by turning off LEDs.
		 */
		//gpio_pin_write(gpio_port, LED_1, LED_ON);
		//gpio_pin_write(gpio_port, LED_2, LED_OFF);
		k_cpu_idle();
		break;

	case SYS_POWER_STATE_DEEP_SLEEP_1:
		printk("--> Entering to SYS_POWER_STATE_DEEP_SLEEP_1 state.\n");

		/*
		 * This power mode is already implemented by the OS. It will be
		 * handled by SoC-specific code. Here we just turn off the LEDs
		 * to save power.
		 */
		//gpio_pin_write(gpio_port, LED_1, LED_ON);
		//gpio_pin_write(gpio_port, LED_2, LED_OFF);

		/* Nothing else to do */
		break;

	default:
		printk("Unsupported power state %u", state);
		break;
	}
}

/*
 * Application defined function for doing any target specific operations
 * for low power exit.
 */
void sys_pm_notify_power_state_exit(enum power_states state)
{
	switch (state) {
	case SYS_POWER_STATE_SLEEP_2:
		printk("--> Exited from SYS_POWER_STATE_SLEEP_2 state.\n");

		/* Perform exit from the low power state by turning on LEDs */
		//gpio_pin_write(gpio_port, LED_1, LED_ON);
		//gpio_pin_write(gpio_port, LED_2, LED_OFF);
		break;

	case SYS_POWER_STATE_SLEEP_3:
		printk("--> Exited from SYS_POWER_STATE_SLEEP_3 state.\n");

		/* Perform exit from the low power state by turning on LEDs */
		//gpio_pin_write(gpio_port, LED_1, LED_ON);
		//gpio_pin_write(gpio_port, LED_2, LED_OFF);
		break;

	case SYS_POWER_STATE_DEEP_SLEEP_1:
		printk("--> Exited from SYS_POWER_STATE_DEEP_SLEEP_1 state.\n");

		/* Turn on LEDs which were powered down before deep sleep. */
		//gpio_pin_write(gpio_port, LED_1, LED_ON);
		//gpio_pin_write(gpio_port, LED_2, LED_OFF);
		break;

	default:
		printk("Unsupported power state %u", state);
		break;
	}
}
```
