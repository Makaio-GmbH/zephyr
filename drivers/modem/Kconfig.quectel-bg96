## drivers/modem/Kconfig.quectel-bg96
```kconfig
# Kconfig - Quectel BG96 driver options

#
# Copyright (c) 2019 Makaio GmbH
#
# SPDX-License-Identifier: Apache-2.0
#

config MODEM_QUECTEL_BG96
	bool "Enable Quectel BG96 NB-IoT/CAT-M/2G modem driver"
	select MODEM_RECEIVER
	select NET_OFFLOAD
	imply GPIO
	help
	  Choose this setting to enable Quectel BG96 modem
	  driver.

if MODEM_QUECTEL_BG96

config MODEM_QUECTEL_BG96_RX_STACK_SIZE
	int "Stack size for the driver RX thread"
	default 1028
	help
	  This stack is used by the RX thread.

config MODEM_QUECTEL_BG96_RX_WORKQ_STACK_SIZE
	int "Stack size for the modem driver work queue"
	default 2048
	help
	  This stack is used by the work queue to pass off net_pkt data
	  to the rest of the network stack, letting the rx thread continue
	  processing data.

config MODEM_QUECTEL_BG96_APN
	string "APN for establishing network connection"
	default "hologram"
	help
	  This setting is used in the AT+CGDCONT command to set the APN name
	  for the network connection context.  This value is specific to
	  the network provider and may need to be changed.

config MODEM_QUECTEL_BG96_MANUAL_MCCMNO
	string "MCC/MNO for establishing network connection"
	help
	  This setting is used in the AT+COPS command to set the MCC/MNO
	  for the network connection context.  This value is specific to
	  the network provider and may need to be changed if auto is not
	  selected.

config MODEM_QUECTEL_BG96_INIT_PRIORITY
	int "Quectel BG96 driver init priority"
	default 80
	help
	  Quectel BG96 device driver initialization priority.
	  Do not mess with it unless you know what you are doing.
	  Note that the priority needs to be lower than the net stack
	  so that it can start before the networking sub-system.

config MODEM_QUECTEL_BG96_SIGNAL_INTERVAL
	int "Refresh interval for signal strength in seconds"
	default 60

endif # MODEM_QUECTEL_BG96
```

## drivers/modem/Kconfig.ublox-sara-u2
```kconfig
# Kconfig - u-blox SARA U2 driver options

#
# Copyright (c) 2019 Makaio GmbH
#
# SPDX-License-Identifier: Apache-2.0
#

config MODEM_UBLOX_SARA_U2
	bool "Enable u-blox SARA-U2 HSPA/2G modem driver"
	select MODEM_RECEIVER
	select NET_OFFLOAD
	imply GPIO
	help
	  Choose this setting to enable u-blox SARA-U2 HSPA/2G modem
	  driver.

if MODEM_UBLOX_SARA_U2

config MODEM_UBLOX_SARA_U2_RX_STACK_SIZE
	int "Stack size for the u-blox SARA-U2 modem driver RX thread"
	default 1028
	help
	  This stack is used by the u-blox SARA-U2 RX thread.

config MODEM_UBLOX_SARA_U2_RX_WORKQ_STACK_SIZE
	int "Stack size for the u-blox SARA-U2 modem driver work queue"
	default 2048
	help
	  This stack is used by the work queue to pass off net_pkt data
	  to the rest of the network stack, letting the rx thread continue
	  processing data.

config MODEM_UBLOX_SARA_U2_APN
	string "APN for establishing network connection"
	default "hologram"
	help
	  This setting is used in the AT+CGDCONT command to set the APN name
	  for the network connection context.  This value is specific to
	  the network provider and may need to be changed.

config MODEM_UBLOX_SARA_U2_MANUAL_MCCMNO
	string "MCC/MNOfor establishing network connection"
	help
	  This setting is used in the AT+COPS command to set the MCC/MNO
	  for the network connection context.  This value is specific to
	  the network provider and may need to be changed if auto is not
	  selected.

config MODEM_UBLOX_SARA_U2_INIT_PRIORITY
	int "u-blox SARA-U2 driver init priority"
	default 80
	help
	  u-blox SARA-U2 device driver initialization priority.
	  Do not mess with it unless you know what you are doing.
	  Note that the priority needs to be lower than the net stack
	  so that it can start before the networking sub-system.

endif # MODEM_UBLOX_SARA_U2
```

## dts/bindings/gpio/nxp,pcal9535a-gpio.yaml
```yaml
# Copyright (c) 2019, Makaio GmbH
# SPDX-License-Identifier: Apache-2.0

title: Nexperia PCAL9535 I2C GPIO

description: >
        This is a representation of the PCAL9535 I/O expander node

compatible: "nxp,pcal9535a"

include: [i2c-device.yaml, gpio-controller.yaml]

properties:
    label:
      required: true

    int-gpios:
      type: phandle-array
      required: false

    "#gpio-cells":
      const: 2

"#cells":
  - pin
  - flags
```

## dts/bindings/modem/quectel,bg96.yaml
```yaml
#
# Copyright (c) 2019, Makaio GmbH
#
# SPDX-License-Identifier: Apache-2.0
#
---
title: Quectel BG96 modem
version: 0.1

description: >
    This is a representation of the Quectel BG96 modem.

inherits:
    !include uart-device.yaml

properties:
    compatible:
      type: string
      category: required
      constraint: "quectel,bg96"
      generation: define

    label:
      type: string
      category: required
      generation: define

    mdm-power-gpios:
      type: compound
      category: required
      generation: define, use-prop-name

    mdm-reset-gpios:
      type: compound
      category: required
      generation: define, use-prop-name

    mdm-vint-gpios:
      type: compound
      category: required
      generation: define, use-prop-name

    mdm-ttlbuff-gpios:
        type: compound
        category: optional
        generation: define, use-prop-name
...
```

## dts/bindings/modem/ublox,sara-u2.yaml
```yaml
#
# Copyright (c) 2019, Makaio GmbH
#
# SPDX-License-Identifier: Apache-2.0
#
---
title: u-blox SARA-U2 modem
version: 0.1

description: >
    This is a representation of the u-blox SARA-U2 modem.

inherits:
    !include uart-device.yaml

properties:
    compatible:
      type: string
      category: required
      constraint: "ublox,sara-u2"
      generation: define

    label:
      type: string
      category: required
      generation: define

    mdm-power-gpios:
      type: compound
      category: required
      generation: define, use-prop-name

    mdm-reset-gpios:
      type: compound
      category: required
      generation: define, use-prop-name

    mdm-vint-gpios:
      type: compound
      category: required
      generation: define, use-prop-name

    mdm-ttlbuff-gpios:
        type: compound
        category: optional
        generation: define, use-prop-name
...
```
